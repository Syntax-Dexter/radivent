## main/Kconfig.projbuild
```kconfig
menu "Radiator Fan Controller"

    menu "NTC Thermistor Parameters"
        config FANCTRL_NTC_NOMINAL_OHM
            int "NTC nominal resistance (ohm @ 25C)"
            default 10000

        config FANCTRL_NTC_BETA
            int "NTC beta coefficient"
            default 3950

        config FANCTRL_NTC_SERIES_OHM
            int "Divider series resistor (ohm)"
            default 10000
    endmenu

    menu "Wireless Features"
        config FANCTRL_ENABLE_ESPNOW
            bool "Enable ESP-NOW"
            default y

        config FANCTRL_ENABLE_MQTT
            bool "Enable MQTT client"
            default y

        config FANCTRL_ENABLE_ZIGBEE
            bool "Enable Zigbee (requires espressif/esp-zigbee-lib managed component)"
            default n
            help
                Requires adding the managed component in main/idf_component.yml:
                  espressif/esp-zigbee-lib
                and enabling CONFIG_ZB_ENABLED via the Zigbee component's own Kconfig.

        config FANCTRL_ENABLE_THREAD
            bool "Enable Thread (OpenThread)"
            default n
            help
                Also requires CONFIG_OPENTHREAD_ENABLED=y (see sdkconfig.defaults) and the
                "openthread" component to be part of the build.
    endmenu

    config FANCTRL_AP_SSID
        string "Default SoftAP SSID"
        default "FanController-Setup"

    config FANCTRL_AP_PASSWORD
        string "Default SoftAP password"
        default "fanctrl123"

endmenu
```
